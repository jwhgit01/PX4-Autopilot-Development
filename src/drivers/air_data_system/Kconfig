## src/drivers/air_data_system/Kconfig
```kconfig
menu "Air data systems"
    menuconfig COMMON_AIR_DATA_SYSTEM
        bool "Common air data systems"
        default n
        select DRIVERS_AIR_DATA_SYSTEM_SPINGARAGE
        ---help---
            Enable default set of air data system drivers

    rsource "*/Kconfig"
endmenu
```

## src/drivers/air_data_system/nsl_adu/Kconfig
```kconfig
menuconfig DRIVERS_AIR_DATA_SYSTEM
	bool "nsl_adu"
	default y
	---help---
		Enable support for nsl_adu
```

## src/drivers/air_data_system/spingarage/Kconfig
```kconfig
menuconfig DRIVERS_AIR_DATA_SYSTEM_SPINGARAGE
	bool "spingarage"
	default y
	---help---
		Enable support for spingarage
```

## src/drivers/airdata/Kconfig
```kconfig
menu "Air data systems"
    menuconfig COMMON_AIRDATA
        bool "Common air data systems"
        default n
        select DRIVERS_AIRDATA_SPINGARAGE
        ---help---
            Enable default set of air data system drivers
    rsource "*/Kconfig"
endmenu
```

## src/drivers/airdata/spingarage/Kconfig
```kconfig
menuconfig DRIVERS_AIRDATA_SPINGARAGE
	bool "spingarage"
	default y
	---help---
		Enable support for spingarage
```

## src/drivers/anemometer/Kconfig
```kconfig
menu "Anemometers"
    menuconfig COMMON_ANEMOMETER
        bool "Common anemometers"
        default n
        select DRIVERS_ANEMOMETER_TRISONICA_MINI
        ---help---
            Enable default set of anemometer drivers
    rsource "*/Kconfig"
endmenu
```

## src/drivers/anemometer/spingarage/Kconfig
```kconfig
menuconfig DRIVERS_ANEMOMETER_SPINGARAGE
	bool "spinagarage"
	default y
	---help---
		Enable support for spingarage
```

## src/drivers/anemometer/trisonica_mini/Kconfig
```kconfig
menuconfig DRIVERS_ANEMOMETER_TRISONICA_MINI
	bool "trisonica_mini"
	default y
	---help---
		Enable support for trisonica_mini
```

## src/drivers/nsl_adu/Kconfig
```kconfig
menuconfig DRIVERS_NSL_ADU
	bool "nsl_adu"
	default y
	---help---
		Enable support for nsl_adu
```
